## rockchip_atk_dlrk3588_defconfig
```kconfig
#include "base/base.config"
#include "chips/rk3588_aarch64.config"
#include "font/chinese.config"
#include "fs/exfat.config"
#include "fs/ntfs.config"
#include "fs/vfat.config"
#include "gpu/gpu.config"
#include "multimedia/audio.config"
#include "multimedia/camera.config"
#include "multimedia/gst/audio.config"
#include "multimedia/gst/camera.config"
#include "multimedia/gst/rtsp.config"
#include "multimedia/gst/video.config"
#include "multimedia/mpp.config"
#include "wifibt/bt.config"
#include "wifibt/wireless.config"
#include "benchmark.config"
#include "chromium.config"
#include "debug.config"
#include "npu2.config"
#include "powermanager.config"
#include "test.config"
#include "weston.config"
#include "qt/qt5.config"
#include "alientek.config"
# BR2_TARGET_ROOTFS_TAR is not set

# Boot into local terminal on MIPI panel instead of Qt desktop.
# BR2_PACKAGE_SYSTEMUI is not set
BR2_TARGET_GENERIC_GETTY=y
BR2_TARGET_GENERIC_GETTY_PORT="tty1"
BR2_TARGET_GENERIC_GETTY_BAUDRATE_KEEP=y
BR2_TARGET_GENERIC_GETTY_TERM="linux"

# Disable user-space display stack that may take over DRM/DSI.
# BR2_PACKAGE_WAYLAND is not set
# BR2_PACKAGE_WESTON is not set
# BR2_PACKAGE_CHROMIUM_WAYLAND is not set
# BR2_PACKAGE_QT5WAYLAND is not set
```
